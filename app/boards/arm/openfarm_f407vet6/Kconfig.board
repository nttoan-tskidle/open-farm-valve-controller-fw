## app/boards/arm/openfarm_f407vet6/Kconfig.board
```kconfig
config BOARD_OPENFARM_F407VET6
	bool "OpenFarm STM32F407VET6 board"
	depends on SOC_SERIES_STM32F4X
```

## app/src/system/board/arm/openfarm_f407vet6/board.yml
```yaml
board:
  name: openfarm_f407vet6
  full_name: OpenFarm STM32F407VET6
  vendor: openfarm
  socs:
    - name: stm32f407xx
```
